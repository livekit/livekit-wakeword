## client/esp32/examples/i2s_mic/sdkconfig.defaults
```kconfig
CONFIG_IDF_TARGET="esp32s3"
CONFIG_ESPTOOLPY_FLASHSIZE_4MB=y
CONFIG_PARTITION_TABLE_SINGLE_APP_LARGE=y
CONFIG_COMPILER_OPTIMIZATION_PERF=y
CONFIG_ESP_DEFAULT_CPU_FREQ_MHZ_240=y
CONFIG_LKWW_MODEL_PATH="../../../../models/hey_livekit_micro.tflite"
```

## client/esp32/examples/livekit_agent/main/Kconfig.projbuild
```kconfig
menu "LiveKit Example"

    choice LK_EXAMPLE_BOARD
        prompt "Board"
        default LK_EXAMPLE_BOARD_M5STACK_TAB5 if IDF_TARGET_ESP32P4
        default LK_EXAMPLE_BOARD_CODEC_BOARD

        config LK_EXAMPLE_BOARD_CODEC_BOARD
            bool "A board known to codec_board (ESP32-S3-BOX-3, ESP32-S3-Korvo-2, ...)"
        config LK_EXAMPLE_BOARD_M5STACK_TAB5
            bool "M5Stack Tab5"
            depends on IDF_TARGET_ESP32P4
    endchoice

    config LK_EXAMPLE_CODEC_BOARD_TYPE
        string "Codec board type"
        depends on LK_EXAMPLE_BOARD_CODEC_BOARD
        default "DUMMY_CODEC_BOARD"
        help
            The model of dev board you are using. See board_cfg.txt from the codec
            board component for a list of supported boards.

    config LK_EXAMPLE_MIC_CHANNELS
        int "Microphone: interleaved channels to open"
        depends on LK_EXAMPLE_BOARD_CODEC_BOARD
        default 4
        range 1 8
    config LK_EXAMPLE_MIC_CHANNEL_MASK
        hex "Microphone: channels kept (0: all)"
        depends on LK_EXAMPLE_BOARD_CODEC_BOARD
        default 0x3
    config LK_EXAMPLE_MIC_LAYOUT
        string "Microphone: layout of the kept channels"
        depends on LK_EXAMPLE_BOARD_CODEC_BOARD
        default "MR"
        help
            One letter per kept channel: M microphone, R playback reference (echo cancellation),
            N unused. The capturer and the wake word both use it. "MR" fits the ESP32-S3-BOX-3.

    config LK_EXAMPLE_MIC_GAIN_DB
        int "Microphone gain (dB)"
        depends on LK_EXAMPLE_BOARD_M5STACK_TAB5
        default 30
        range 0 37

    choice LK_EXAMPLE_CONNECTION_METHOD
        prompt "Choose room connection method"
        help
            Choose how to connect to the room in the example.

        config LK_EXAMPLE_USE_SANDBOX
            bool "Sandbox token"
            help
                Use a sandbox token server for room authentication.

        config LK_EXAMPLE_USE_PREGENERATED
            bool "Pre-generated token"
            help
                Use a pre-generated token and server URL for room connection.
    endchoice

    config LK_EXAMPLE_SERVER_URL
        depends on LK_EXAMPLE_USE_PREGENERATED
        string "Server URL"
        default "ws://localhost:7880"
        help
            The server URL to use for room connection.
    config LK_EXAMPLE_TOKEN
        depends on LK_EXAMPLE_USE_PREGENERATED
        string "Token"
        help
            The token to use for room connection.

    config LK_EXAMPLE_SANDBOX_ID
        depends on LK_EXAMPLE_USE_SANDBOX
        string "Sandbox ID"
        help
            The ID of the sandbox token server to use.
    config LK_EXAMPLE_ROOM_NAME
        depends on LK_EXAMPLE_USE_SANDBOX
        string "Room name (optional)"
        help
            Specific room name sandbox tokens will be generated with.
    config LK_EXAMPLE_PARTICIPANT_NAME
        depends on LK_EXAMPLE_USE_SANDBOX
        string "Participant name (optional)"
        help
            Specific participant name sandbox tokens will be generated with.

    config LK_EXAMPLE_SPEAKER_VOLUME
        int "Default speaker volume (0-100%)"
        default 85
        range 0 100
        help
            Default playback volume for speaker output.

endmenu
```

## client/esp32/examples/livekit_agent/sdkconfig.defaults
```kconfig
# Common to all targets; see sdkconfig.defaults.<target> for the boards.
CONFIG_LK_EXAMPLE_SPEAKER_VOLUME=100
CONFIG_CODEC_I2C_BACKWARD_COMPATIBLE=n

CONFIG_COMPILER_OPTIMIZATION_PERF=y
CONFIG_ESP_WS_CLIENT_ENABLE_DYNAMIC_BUFFER=y
CONFIG_ESP_WS_CLIENT_SEPARATE_TX_LOCK=y
CONFIG_ESPTOOLPY_FLASHSIZE_16MB=y
CONFIG_FREERTOS_HZ=1000
CONFIG_FREERTOS_TIMER_TASK_STACK_DEPTH=4096
CONFIG_IDF_EXPERIMENTAL_FEATURES=y
CONFIG_LWIP_SNTP_MAX_SERVERS=2
CONFIG_MBEDTLS_EXTERNAL_MEM_ALLOC=y
CONFIG_MBEDTLS_SSL_DTLS_SRTP=y
CONFIG_MBEDTLS_SSL_PROTO_DTLS=y
CONFIG_PARTITION_TABLE_CUSTOM=y
CONFIG_SPIRAM_MALLOC_ALWAYSINTERNAL=256
CONFIG_SPIRAM_MALLOC_RESERVE_INTERNAL=8192
CONFIG_SPIRAM_TRY_ALLOCATE_WIFI_LWIP=y
CONFIG_SPIRAM=y

# livekit-wakeword
CONFIG_LKWW_MODEL_PATH="../../../../models/hey_livekit_micro.tflite"
```

## client/esp32/livekit_wakeword/Kconfig
```kconfig
menu "livekit-wakeword"

    config LKWW_MODEL_PATH
        string "Wake word model (.tflite) to embed"
        default ""
        help
            <name>_micro.tflite from `livekit-wakeword train --type micro`, relative to the
            project. Embedded in the firmware and used by LKWW_DEFAULT_CONFIG(); leave empty to
            pass your own model to lkww_create().

    config LKWW_ARENA_KB
        int "TensorFlow Lite Micro arena (KB, 0: size it to the model)"
        default 0
        range 0 1024
        help
            Working memory for the model. 0 measures what the model needs when the detector is
            created (it briefly takes the largest free block, up to 256 KB) and allocates exactly
            that; set a size to skip the measurement.

    config LKWW_ARENA_IN_PSRAM
        bool "Allocate the arena in PSRAM"
        default n
        depends on SPIRAM
        help
            Saves internal SRAM at the cost of slower inference.

    config LKWW_TASK_CORE
        int "Core for the inference task (-1: any)"
        default 1
        range -1 1

    config LKWW_TASK_PRIORITY
        int "Inference task priority"
        default 5

endmenu
```
